## components/audio_fe/Kconfig
```kconfig
menu "Audio Front-End"

    config AUDIO_FE_MODEL_PARTITION
        string "Model partition label"
        default "model"
        help
            从该 data/spiffs 分区加载 ESP-SR 模型（见 partitions.csv）。

    config AUDIO_FE_INPUT_FORMAT
        string "AFE input format"
        default "M"
        help
            AFE 输入通道格式：M=单麦，MR=单麦+参考，MMR=双麦+参考。
            本期硬件为单麦（INMP441），固定 "M"。

    config AUDIO_FE_UPLINK_RING_MS
        int "Uplink ring depth (ms of 16k mono audio)"
        range 0 8000
        default 2000
        help
            上行 PCM 环形缓冲深度（16k/单声道/int16，放 PSRAM）。
            0 = 关闭上行接口（audio_fe_uplink_* 返回 ESP_ERR_NOT_SUPPORTED）。
            默认 2000ms → 32768 样本（2.048s，64KB PSRAM）：足够吸收编码/发送
            任务调度抖动，又能把上行时延限制在可接受范围（架构 §6.4 首帧 <200ms）。


    config AUDIO_FE_RESUME_DISCARD_MS
        int "恢复收音后丢弃的最早音频（毫秒，规则 R5）"
        range 0 200
        default 50
        help
            半双工规则 R5（ARCH §3.3）：打断恢复 feed 后，前 N 毫秒的麦克风数据喂零，
            避免打断瞬间的功放余响/开关噪声触发 VAD。voice_session 的 R4 打断路径用
            该值调用 audio_fe_feed_discard_ms()；正常 TTS 收尾走 R2 的 300ms 尾部延时，
            不使用 R5。

    config AUDIO_FE_AEC_ENABLE
        bool "启用软件参考 AEC（T4.4 C3 spike）"
        default n
        help
            开启后 audio_fe 在 feed 任务里用 esp_aec 处理麦克风：参考取自 audio_player
            的混音输出（post 音量/duck/限幅），无播放（speaker 未开）或 R1 hold 时旁路。
            caps 走 PSRAM；**量产默认关闭，需真实声学验证后再评估默认值**。

    choice AUDIO_FE_AEC_MODE
        prompt "AEC 模式"
        depends on AUDIO_FE_AEC_ENABLE
        default AUDIO_FE_AEC_MODE_SR_HIGH_PERF
        help
            SR_LOW_COST/SR_HIGH_PERF 面向唤醒；FD_LOW_COST 带 NLP，双讲更好但更重。
            实测（合成回声，内部 RAM/单帧）：SR filter=2 +6.4KB/0.81ms；
            SRH filter=2 +4.4KB/1.78ms；FD +12.7KB/6.9ms。

        config AUDIO_FE_AEC_MODE_SR_LOW_COST
            bool "SR_LOW_COST"
        config AUDIO_FE_AEC_MODE_SR_HIGH_PERF
            bool "SR_HIGH_PERF"
        config AUDIO_FE_AEC_MODE_FD_LOW_COST
            bool "FD_LOW_COST（双讲）"
    endchoice

    config AUDIO_FE_AEC_FILTER_LEN
        int "AEC filter_length"
        depends on AUDIO_FE_AEC_ENABLE
        range 1 8
        default 2
        help
            官方推荐 4；实测 2 的内部 RAM/CPU 约减半（+6.4KB/0.81ms @SR），
            但覆盖的延迟/混响更短，需真实声学验证（C3）。

    config AUDIO_FE_AEC_REF_DELAY_MS
        int "AEC 参考延迟（毫秒）"
        depends on AUDIO_FE_AEC_ENABLE
        range 0 300
        default 40
        help
            参考环读取相对播放写指针的延迟，用于对齐 DMA/功放/声学路径。
            真机按 ERLE/唤醒率扫描（runtime `aec delay <ms>`）。

    config AUDIO_FE_AEC_TTS_BARGEIN
        bool "TTS 播放期间保持开麦（AEC barge-in spike）"
        depends on AUDIO_FE_AEC_ENABLE
        default n
        help
            仅用于 T4.4 C4 spike：TTS 播放时**不 hold mic**，让 WakeNet 继续听，
            由 AEC 用 TTS 参考抵消自播；voice_session 只计数
            （`vs status` 的“TTS 中唤醒”），不真正打断。验证通过后再决定是否正式实现。

    config AUDIO_FE_AEC_BYPASS_WHEN_IDLE
        bool "无播放时旁路 AEC"
        depends on AUDIO_FE_AEC_ENABLE
        default y
        help
            speaker 未开（无音乐/TTS/提示音）时直接喂原始麦克风，保持现有安静
            环境唤醒基线；关闭后全程过 AEC（便于对比）。

endmenu
```

## components/audio_player/Kconfig
```kconfig
menu "Audio Player"

    config AUDIO_PLAYER_DEFAULT_VOLUME
        int "Default volume (0-100)"
        range 0 100
        default 60

    config AUDIO_PLAYER_TAIL_DELAY_MS
        int "Tail delay after playback before done callback (ms)"
        default 300
        help
            播放结束后等待该时长再回调，用于吸收喇叭尾音（半双工规则 R2）。

    config AUDIO_PLAYER_ENABLE_MP3
        bool "启用 MP3 解码（T2.3，minimp3）"
        default y
        help
            TTS/音乐下行统一用 MP3（ARCH §3.7）。解码器为 vendored minimp3
            （third_party/minimp3，CC0），状态与临时区全部放 PSRAM，
            内部 RAM 增量 0（CONVENTIONS §4）。
            关闭后 audio_player_play_mp3() 返回 ESP_ERR_NOT_SUPPORTED，
            提示音（PCM）链路不受影响，固件体积减少约 40KB。

    config AUDIO_PLAYER_MP3_PCM_MAX_BYTES
        int "MP3 解码 PCM 缓冲上限（PSRAM，字节）"
        depends on AUDIO_PLAYER_ENABLE_MP3
        default 524288
        range 65536 4194304
        help
            整段解码路径（audio_player_play_mp3）把整段解成单声道 PCM 放在这块
            预分配缓冲里（播放任务内禁止 malloc）。T2.4 流式播放不走这里，
            512KB ≈ 24k 单声道 10.9s；超长整段素材会被拒绝并打 WARN。

    config AUDIO_PLAYER_STREAM_RING_BYTES
        int "流式播放 PSRAM 压缩数据 ring（字节）"
        depends on AUDIO_PLAYER_ENABLE_MP3
        default 65536
        range 8192 1048576
        help
            T2.4 流式播放：voice_cloud 把下行 MP3 字节写入这块 PSRAM ring，
            player 任务边收边解。64KB ≈ 24k/64kbps 约 8s 缓冲。

    config AUDIO_PLAYER_STREAM_PREROLL_FRAMES
        int "流式起播最少已解码帧数"
        depends on AUDIO_PLAYER_ENABLE_MP3
        default 4
        range 1 32
        help
            解出该帧数就起播（24kHz 单帧 24ms），与 PREROLL_MS 取先到者。
            首帧到出声 <150ms 是 P2 验收项。

    config AUDIO_PLAYER_STREAM_PREROLL_MS
        int "流式起播超时（距首个 write，毫秒）"
        depends on AUDIO_PLAYER_ENABLE_MP3
        default 120
        range 10 2000
        help
            即使还没解够 PREROLL_FRAMES 帧，距首字节超过该时长也起播，
            避免弱网/小帧流迟迟不出声。


    config AUDIO_PLAYER_MUSIC_RING_MS
        int "音乐 PCM ring 时长（毫秒，48k 单声道）"
        depends on AUDIO_PLAYER_ENABLE_MP3
        default 1000
        range 200 4000
        help
            T4.1：music_http 任务解码出的 48k PCM 先写这块 PSRAM ring，
            由混音级按 10ms 块搬进 CH_MUSIC。1000ms 覆盖 WiFi 抖动；
            越大越抗抖，但 PSRAM 占用 = 48k × 2B × ms。

    config AUDIO_PLAYER_MUSIC_URL_MAX
        int "音乐 URL 最大长度（字节）"
        depends on AUDIO_PLAYER_ENABLE_MP3
        default 320
        range 64 1024
        help
            music_http 任务保存 URL 的静态缓冲。URL 来自服务端 music_track，
            端侧只做 http(s) 前缀与长度校验；超长直接拒绝（不截断）。

    config AUDIO_PLAYER_MUSIC_TASK_STACK
        int "music_http 任务栈（字节）"
        depends on AUDIO_PLAYER_ENABLE_MP3
        default 6144
        range 4096 12288
        help
            T4.1 拉流任务（HTTP/TLS + MP3 解码 + 重采样）。任务按需创建，
            停止后销毁；栈在任务存活期占内部 RAM，所以不要随意加大。

    config AUDIO_PLAYER_MUSIC_HTTP_TIMEOUT_MS
        int "音乐 HTTP 读超时（毫秒）"
        depends on AUDIO_PLAYER_ENABLE_MP3
        default 2000
        range 500 10000
        help
            esp_http_client 的连接/读超时。停止时任务最多阻塞这么久后退出。

    config AUDIO_PLAYER_MUSIC_PREFILL_MS
        int "音乐起播预缓冲（毫秒，48k 单声道）"
        depends on AUDIO_PLAYER_ENABLE_MP3
        default 200
        range 50 1000
        help
            T4.5：起播前先解出至少该时长的 PCM 再进混音，避免起播空 ring 欠载。
            T4.1/T4.3 为 150ms；T4.5 提到 200ms（真机首声仍目标 <1.5s）。

    config AUDIO_PLAYER_MUSIC_RECONNECT_MAX
        int "音乐断流重连次数（每次断流）"
        depends on AUDIO_PLAYER_ENABLE_MP3
        default 3
        range 0 10
        help
            T4.5：HTTP 读失败/服务端提前关闭时，用 Range 从上次字节偏移续播，
            最多重试该次数（含首次重连）；0=不重连（回退到 T4.1 行为）。

    config AUDIO_PLAYER_MUSIC_RECONNECT_BACKOFF_MS
        int "音乐重连退避（毫秒，线性递增）"
        depends on AUDIO_PLAYER_ENABLE_MP3
        default 300
        range 50 2000
        help
            第 n 次重连前等待 n × 该值；暂停期间不重连（恢复后再试）。

    config AUDIO_PLAYER_INTERRUPT_FADE_MS
        int "按键打断淡出时长（毫秒，规则 R4）"
        range 20 100
        default 80
        help
            audio_player_fade_out_and_stop() 的默认时长（voice_session 的 R4 打断用它）。
            P3 验收口径是"按键打断 <100ms 停声"：80ms 淡出 + 一块 10ms 输出块 + 事件投递
            余量，T3.2/T3.3 真机实测 last_stop_ms 64~84ms。改大就必然超线，不要为了听感调大。

    config AUDIO_PLAYER_DUCK_DB
        int "音乐 duck 深度（dB，规则 R3）"
        range 3 30
        default 12
        help
            R3：音乐播放中唤醒，音乐在 100ms 内 duck 到该深度（相对当前音量的增益）。
            架构定稿 -12dB，约 0.25 倍振幅。

    config AUDIO_PLAYER_DUCK_RAMP_MS
        int "通道增益/duck 斜坡时长（毫秒）"
        range 10 500
        default 100
        help
            R3 的"100ms 内 duck 到 -12dB"由它保证：CH_MUSIC 的 q16 通道增益按该时长
            线性走到目标（T3.3 起 duck 是通道增益，不再压整个输出）。仅当目标变化时
            按本时长重算一次步进（块内逐样本推进），不要改成每块按剩余差重算。

endmenu
```

## components/config_store/Kconfig
```kconfig
menu "Config Store"

    config CFG_VOLUME_DEFAULT
        int "Default volume when NVS has no stored value (0-100)"
        range 0 100
        default 100
        help
            首次上电或 NVS 中没有 volume 键时的音量。默认 100 来自 2026-10-31
            用户听感定稿（T2.4 实播云端 TTS 素材，软件音量 100 时音量合适；
            提示音"我在呢"峰值 -7.8 dBFS，100 不削波）。必须与 ARCHITECTURE §3.5 一致；
            audio_player 自己的 CONFIG_AUDIO_PLAYER_DEFAULT_VOLUME 仅表示"未被 app
            设置前"的上电缺省，启动后以 config_store 的值为准（T3.3 统一音量体系时合并）。

endmenu
```

## components/dev_ctrl/Kconfig
```kconfig
menu "Dev Ctrl（按键/静音，T3.4）"

    config DEV_ENABLE
        bool "启用按键/静音控制（dev_ctrl）"
        default y
        help
            ARCHITECTURE §4.1：GPIO0 按键扫描（短按投 APP_EVT_BUTTON 由 voice_session 消费）、
            长按静音切换。关闭后组件全部接口为空实现（链接不报错），
            物理交互能力同时消失；量产不建议关闭（按键是半双工打断的兜底手段）。

    config DEV_BUTTON_DEBOUNCE_MS
        int "按键去抖时间（毫秒）"
        range 10 100
        default 30
        depends on DEV_ENABLE
        help
            10ms 周期采样，连续这么长时间电平一致才认定一次真实边沿。
            机械按键典型抖动 5~20ms，30ms 留余量；过大增加短按响应时延（<100ms 验收口径）。

    config DEV_BUTTON_LONG_PRESS_MS
        int "长按判定阈值（毫秒）"
        range 200 3000
        default 600
        depends on DEV_ENABLE
        help
            按住超过该时长触发长按（静音切换），释放时不再报短按。
            常见语音助手取 500ms~1s，600ms 兼顾误触与响应速度。

endmenu
```

## components/diag/Kconfig
```kconfig
menu "Diagnostics"

    config DIAG_HEAP_MONITOR
        bool "周期堆水位监控任务"
        default n
        help
            建一个低优先级任务，按固定间隔打印内部 RAM / PSRAM 的水位。
            供 P5 长稳压测（T5.3）观察堆是否单调下降；默认关闭，避免污染常规日志。

    config DIAG_HEAP_MONITOR_INTERVAL_S
        int "堆水位打印间隔（秒）"
        depends on DIAG_HEAP_MONITOR
        range 5 3600
        default 30

    config DIAG_ENABLE_CRASH_TEST
        bool "启用 sys crash 崩溃测试命令（仅开发期）"
        default n
        help
            编译进 `sys crash` 子命令，主动触发 panic 以验证 coredump 分区
            是否能正常落盘、能否用 `idf.py coredump-info` 解析。
            **量产固件必须关闭**（默认 n，sdkconfig.defaults 里显式开启仅供开发板）。

    config DIAG_ENABLE_PLAYER_TEST
        bool "启用 player MP3 播放探针（仅开发期）"
        default n
        help
            编译进 `player` 命令：`player load begin/chunk/end` 把 PC 侧准备好的
            MP3（base64 分块，存 PSRAM）传到设备，`player mp3` 交给播放任务解码播放，
            `player stat` 打印解码/播放统计。用于 T2.3 验收（素材含真实电台码流）。
            **量产固件必须关闭**（默认 n，sdkconfig.defaults 里显式开启仅供开发板）。
            开启时 console 行缓冲 128 → 1024 B（约 +1KB 内部堆），上传才不至于太慢。

    config DIAG_PLAYER_TEST_MAX_BYTES
        int "player 探针的 MP3 上传缓冲上限（PSRAM，字节）"
        depends on DIAG_ENABLE_PLAYER_TEST
        default 524288
        range 16384 2097152

    config DIAG_ENABLE_AEC_TEST
        bool "启用 AEC spike 探针（仅开发期，T4.4b）"
        default n
        help
            编译进 `aec test [sr|fd] [psram|internal] [frames]`：创建一个 esp_aec 实例，
            用合成参考/回声跑 ERLE 与单帧耗时，并打印内部 RAM/PSRAM 增量。
            用于 PD-007 的 AEC 可行性评估（内存/CPU/算法基本正确性）。
            **量产固件必须关闭**（默认 n；本地 sdkconfig 临时开启）。

endmenu
```

## components/event_bus/Kconfig
```kconfig
menu "Event Bus"

    config EVENT_BUS_QUEUE_SIZE
        int "事件循环队列长度（项）"
        range 4 64
        default 16
        help
            自定义 esp_event 循环的队列深度。队列满时 app_evt_post() 立即返回
            ESP_ERR_TIMEOUT 并丢弃事件（非阻塞，音频任务不允许等待），同时打 WARN。
            16 项足够覆盖 NET_UP/DOWN、唤醒/VAD、会话事件在半双工一轮内的突发；
            调大前先评估内部 RAM（每项约 20 B）与处理器耗时。

endmenu
```

## components/music_session/Kconfig
```kconfig
menu "Music Session (音乐控制 T4.3)"

    config MS_PAUSE_FADE_MS
        int "音乐暂停淡出时长（毫秒）"
        range 20 500
        default 100
        help
            T4.3：暂停/语音抢占时对 CH_MUSIC 做线性淡出，然后退出 PUMP 作业
            （保留 ring/wr/rd，resume 从暂停点续播）。淡出太短会有 pop，
            太长会让"暂停 1s 内静音"的真机验收（PV-014）更容易踩线。

    config MS_AUTO_PAUSE_ON_VOICE
        bool "语音进入活跃态时自动暂停音乐"
        default y
        help
            契约 §4：语音进入 LISTENING/THINKING/SPEAKING/FOLLOW_UP/ERROR 时，
            音乐 PLAYING 且不是用户暂停 → auto-pause（pause_reason=2）。
            T4.4（2026-11-11 用户定稿）走 pause 模式：语音回 IDLE 不自动恢复，
            等用户说"继续"；本开关控制"语音活跃时是否让路"。

    config MS_RESUME_FALLBACK_REQUEST
        bool "继续失败时兜底发一次 music_request"
        default y
        help
            长暂停后服务端 idle 超时/TCP 断，播放器 resume 可能拿不到数据。
            开启后每个暂停周期最多发一次 music_request{play,index=0}（服务端自选），
            由服务端重新下发 music_track（T4.5 用 Range 做真续播前的临时兜底）。

    config MS_STATUS_PERIOD_MS
        int "music_status 周期上报（毫秒）"
        range 1000 60000
        default 5000
        help
            状态变化仍立即上报一次；播放中/暂停中都按本周期上报
            （paused 时 progress_ms 冻结）。EOF 探测也复用这个定时器。

    config MS_PLAY_RETRY_MS
        int "起播/切歌重试间隔（毫秒）"
        range 20 1000
        default 120
        help
            切歌 = 先 stop_url() 再 play_url()。停止是异步的（music_http 任务要退出），
            旧任务未退出时 play_url 返回 ESP_ERR_INVALID_STATE，按本间隔重试。

    config MS_PLAY_MAX_RETRIES
        int "起播/切歌最大重试次数"
        range 0 50
        default 15
        help
            默认 120ms × 15 ≈ 1.8s，覆盖 HTTP 读超时内的任务退出窗口；
            超过仍失败按 MC_STATE_ERROR 上报并投 APP_EVT_MUSIC_ERROR。

    config MS_EOF_GUARD_MS
        int "起播后 EOF 保护窗口（毫秒）"
        range 500 10000
        default 1500
        help
            play_url 成功只代表 music_http 任务已创建；HTTP 建连/预填期间
            audio_player_music_active() 还是 false，不能据此判"播完了"。
            窗口内 EOF 探测直接跳过（沿用 T4.2 的 1.5s 口径）。

endmenu
```

## components/net_mgr/Kconfig
```kconfig
menu "Network Manager"

    config NET_SNTP_SERVER
        string "SNTP server"
        default "ntp.aliyun.com"
        help
            NTP 服务器域名/IP。对时用于 TLS 证书校验；国内网络建议保留默认值，
            海外环境可改成 pool.ntp.org。对时失败不影响联网与本地功能。

endmenu
```

## components/transport_ws/Kconfig
```kconfig
menu "WebSocket Transport"

    config WS_TX_QUEUE_BYTES
        int "发送队列总容量（字节，放 PSRAM）"
        range 1024 32768
        default 8192
        help
            transport_ws 的发送队列：ws_send_text/ws_send_bin 只入队（非阻塞），
            由 `ws` 任务按序发出。队列放在 PSRAM（CONVENTIONS §4；PRODUCT_IDEAS §8 X3
            方案 D：原设计 24KB 内部 RAM 改为 8KB PSRAM）。队列满时丢帧 + 限频 WARN，
            绝不阻塞调用方（音频路径只能入队，不能等）。

    config WS_TX_MSG_BYTES
        int "发送队列单槽大小（字节）"
        range 128 1024
        default 256
        help
            单个待发消息的上限，直接影响队列槽位数（= 总容量 / 单槽）。
            当前上行帧是 Opus 20ms（payload 约 40B + 8B 头），文本帧是短视频 JSON，
            256B 足够；改大前先评估 PSRAM 占用。

    config WS_TASK_STACK
        int "`ws` 任务栈（字节）"
        range 4096 8192
        default 6144
        help
            按 ARCHITECTURE §9.3：核 0 / 优先级 5 / 6KB。负责任务状态机、退避、
            心跳与发送队列出队。

    config WS_CLIENT_TASK_STACK
        int "esp_websocket_client 内部任务栈（字节）"
        range 3072 8192
        default 6144
        help
            WS 客户端的收包/握手任务（库任务，类似 wifi/sys_evt，不占 §9.3 的应用任务表）。
            它要跑 TLS 握手与事件分发，实测默认 4096 偏紧；默认按 6KB 留余量。

    config WS_RX_BUFFER_BYTES
        int "单帧收包缓冲（字节）"
        range 1024 4096
        default 2048
        help
            下行单帧最大长度；超过会被客户端分片，本组件按 payload_offset 重组，
            重组后仍超过该值则丢弃并 WARN（计入 rx_bad）。当前最大的下行帧是
            TTS 音频帧（8B 头 + 约 200B payload）与短 JSON。

    config WS_SEND_TIMEOUT_MS
        int "单次发送超时（毫秒）"
        range 100 5000
        default 1000
        help
            `ws` 任务调用 esp_websocket_client_send_* 的超时，只影响 `ws` 任务自身；
            调用方永不等待（只入队）。

endmenu
```
