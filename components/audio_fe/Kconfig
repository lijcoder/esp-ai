## components/voice_cloud/Kconfig
```kconfig
menu "Voice Cloud (上行语音链路)"

    config VC_TASK_STACK
        int "`vc` 任务栈（字节）"
        range 4096 12288
        default 8192
        help
            按 ARCHITECTURE §9.3：核 0 / 优先级 4 / 8KB。上行循环与 Opus 编码都在本任务里串行，
            libopus 的临时数组走 PSRAM 伪栈（codec_enc Kconfig），任务栈只需容纳调用链与
            JSON 小缓冲，8KB 有余量；改小前先看 `sys tasks` 的栈余量。

    config VC_TASK_PRIORITY
        int "`vc` 任务优先级"
        range 1 9
        default 4
        help
            低于 ws/evt（5），高于纯后台任务。编码每 20ms 约 6~7ms，留足余量给网络任务。

    config VC_TASK_CORE
        int "`vc` 任务绑核（0=协议核，1=音频核）"
        range 0 1
        default 0
        help
            核 1 只跑音频实时路径（afe_feed/afe_fetch/player），编码与收发放核 0，
            避免与 AFE 抢核导致 I2S 欠载。

    config VC_VAD_SILENCE_MS
        int "VAD 静音多久结束一轮（毫秒）"
        range 200 3000
        default 800
        help
            ARCHITECTURE §3.6/§7：VAD 判定静音持续 800ms 发 audio_end。
            口径：至少出现过一次人声（vad_active）后，AFE 连续静音达到该时长才收尾；
            若用户一直不说话，由 VC_MAX_UTTER_MS 兜底。

    config VC_MAX_UTTER_MS
        int "单轮累计收音上限（毫秒）"
        range 1000 15000
        default 8000
        help
            ARCHITECTURE §3.6：累计收音 8s 上限，到点强制 audio_end，防止服务端无限等待。
            该值同时决定"用户不说话时一轮最长占用上行"。

    config VC_READ_TIMEOUT_MS
        int "上行 PCM 读超时（毫秒）"
        range 10 200
        default 50
        help
            audio_fe_uplink_read() 的等待上限。AFE 每帧 32ms 输出，50ms 足够且能让
            vc_stop()/断链在 ~50ms 内被响应；不要设 0（会退化成忙轮询）。

    config VC_UPLINK_PREROLL_MS
        int "续听预录保留时长（毫秒，0=不裁剪）"
        range 0 2048
        default 1000
        help
            T3.7：进入 FOLLOW_UP 续听窗口就绪即开始写上行环形缓冲（容量 2048ms），
            起轮时保留最近该时长的音频再上传。用来覆盖「VAD 判定延迟 + 250ms 人声
            确认窗口」这段起轮前的语音——否则续听轮只能听到用户说话的后半句
            （T3.7 实测缺陷，2026-11-03 修复）。设 0 表示不裁剪（最多整环 2048ms）。

    config VC_RESPONSE_TIMEOUT_MS
        int "audio_end 后等云端响应的超时（毫秒）"
        range 1000 60000
        default 10000
        help
            ARCHITECTURE §7：THINKING 阶段 10s 超时。超时后本轮结束（T3.1 落地后由
            voice_session 播错误提示音），本组件只回到 IDLE。

endmenu
```

## components/voice_session/Kconfig
```kconfig
menu "Voice Session (会话状态机)"

    config VS_ERROR_HOLD_MS
        int "ERROR 状态兜底看门狗（毫秒）"
        range 0 10000
        default 3000
        help
            ARCHITECTURE §7：ERROR 状态播异常提示音后回 IDLE，同轮不重试。

            T3.6 起 ERROR 的收尾由 feedback 组件的提示音完成回调驱动（正常 0.8~1.6s），
            本值只是**兜底看门狗**：提示音卡住/播放器异常/回调丢失时强制中止反馈并回 IDLE，
            避免状态机卡在 ERROR、R1 门控（PROMPT 位）没人释放。0 = 关闭看门狗（不建计时器）。

            BLE 说明：3000ms 覆盖「等 TTS 流 abort（≤100ms）+ 提示音 ≤1.6s + 队列/300ms R2 余量」。
            本组件不新建任务（CONVENTIONS §4 内部 RAM 水位约束），该值只影响一个一次性
            esp_timer，不占任务栈。

    config VS_FOLLOWUP_ENABLE
        bool "连续对话（免唤醒续听窗口，T3.7）"
        default y
        help
            ARCHITECTURE §7：TTS 回答播完后不直接回 IDLE，而是进入 FOLLOW_UP 续听窗口：
            用户在窗口内直接说话（VAD 判到人声）就开始下一轮，不用再说唤醒词、不再播应答提示音；
            窗口内静音超时 / 达到轮数上限 / 按键打断 / 断网 → 回 IDLE。
            窗口内再次说出唤醒词 = 重开一轮（播应答提示音、轮数清零）。

            关闭后行为与 T3.1 完全一致（SPEAKING 结束直接回 IDLE）。
            窗口计时用一次 esp_timer（不新增任务；内存实测见 STATUS 基线）。

    config VS_FOLLOWUP_WINDOW_MS
        int "续听窗口时长（毫秒）"
        range 1000 15000
        default 5000
        depends on VS_FOLLOWUP_ENABLE
        help
            TTS 播完后等待用户开口的时长；窗口内没有 VAD 人声就回 IDLE。
            太短用户来不及接话，太长会放大环境噪声误触发；默认 5s（常见语音助手取值）。

    config VS_FOLLOWUP_CONFIRM_MS
        int "续听起轮的人声确认时长（毫秒）"
        range 0 1000
        default 250
        depends on VS_FOLLOWUP_ENABLE
        help
            VAD 报"人声开始"后先观察这么久，仍然是人声才真正起下一轮：
            过滤短促的环境噪声/咔哒声，避免连续对话被噪声误触发。
            0 = 不确认（VAD 一报就起轮，抗噪最差）。

    config VS_FOLLOWUP_MAX_ROUNDS
        int "连续对话最多续听轮数"
        range 1 20
        default 5
        depends on VS_FOLLOWUP_ENABLE
        help
            首轮唤醒之后，最多允许 CONTINUE 的免唤醒轮数（默认 5 轮）。
            达到上限后本次会话回到 IDLE，避免环境噪声导致无限空转/持续云端请求。
            每次重新唤醒会清零计数。

endmenu
```

## main/Kconfig.projbuild
```kconfig
menu "AI Device (WiFi / Cloud / Device)"

    config AI_WIFI_SSID
        string "Wi-Fi SSID (2.4GHz)"
        default ""
        help
            设备联网用的 SSID。真实值写在本地 sdkconfig（已 gitignore）或 menuconfig 里，
            不要提交到仓库、不要写进 sdkconfig.defaults*。

    config AI_WIFI_PASSWORD
        string "Wi-Fi password"
        default ""
        help
            真实密码同样只放本地 sdkconfig。代码与日志都不得打印该值。

    config AI_WS_URL
        string "Cloud WebSocket URL"
        default ""
        help
            形如 wss://<host>/v1/voice?device_id=<id>&token=<token>&ver=1（见 ARCHITECTURE §6.1）。
            本地联调可用 tools/ws_mock_server.py 打印的 ws:// 地址（见 tools/README.md）。
            留空时 T1.4 启动会明确报错，而不是静默连不上。

    config AI_DEVICE_ID
        string "Device ID"
        default ""
        help
            设备唯一标识，握手与鉴权用（ARCHITECTURE §6.1）。

    config AI_TOKEN
        string "Device auth token"
        default ""
        help
            设备鉴权 token；只放本地 sdkconfig，禁止提交、禁止打日志。

endmenu
```
